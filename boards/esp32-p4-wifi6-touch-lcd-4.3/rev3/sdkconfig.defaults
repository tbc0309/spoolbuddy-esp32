## boards/esp32-p4-wifi6-touch-lcd-4.3/rev3/sdkconfig.defaults
```kconfig
CONFIG_IDF_TARGET="esp32p4"
CONFIG_ESP32P4_REV_MIN_300=y
CONFIG_ESPTOOLPY_FLASHMODE_QIO=y
CONFIG_ESPTOOLPY_FLASHSIZE_32MB=y
CONFIG_SPIRAM=y
CONFIG_SPIRAM_SPEED_250M=y
CONFIG_SPIRAM_XIP_FROM_PSRAM=y
CONFIG_CACHE_L2_CACHE_256KB=y
CONFIG_CACHE_L2_CACHE_LINE_128B=y
CONFIG_SLAVE_IDF_TARGET_ESP32C6=y
CONFIG_ESP_WIFI_REMOTE_LIBRARY_HOSTED=y
CONFIG_ESP_HOSTED_SDIO_HOST_INTERFACE=y
CONFIG_ESP_HOSTED_SDIO_SLOT_1=y
CONFIG_ESP_HOSTED_SDIO_4_BIT_BUS=y
CONFIG_ESP_HOSTED_PRIV_SDIO_PIN_CLK_SLOT_1=18
CONFIG_ESP_HOSTED_PRIV_SDIO_PIN_CMD_SLOT_1=19
CONFIG_ESP_HOSTED_PRIV_SDIO_PIN_D0_SLOT_1=14
CONFIG_ESP_HOSTED_PRIV_SDIO_PIN_D1_4BIT_BUS_SLOT_1=15
CONFIG_ESP_HOSTED_PRIV_SDIO_PIN_D2_4BIT_BUS_SLOT_1=16
CONFIG_ESP_HOSTED_PRIV_SDIO_PIN_D3_4BIT_BUS_SLOT_1=17
CONFIG_ESP_HOSTED_SDIO_GPIO_RESET_SLAVE=54
CONFIG_SB_NFC_SCK=2
CONFIG_SB_NFC_MOSI=3
CONFIG_SB_NFC_MISO=4
CONFIG_SB_NFC_CS=5
CONFIG_SB_NFC_BUSY=21
CONFIG_SB_NFC_RST=22
CONFIG_PARTITION_TABLE_CUSTOM_FILENAME="boards/esp32-p4-wifi6-touch-lcd-4.3/rev3/partitions.csv"
CONFIG_BOOTLOADER_APP_ROLLBACK_ENABLE=y

# P4 SDIO DMA can access aligned PSRAM; preserve internal RAM for TCP and SD.
CONFIG_ESP_HOSTED_MEMPOOL_PREFER_SPIRAM=y

# General allocations spill to PSRAM early; keep a protected internal reserve.
CONFIG_SPIRAM_MALLOC_ALWAYSINTERNAL=1024
CONFIG_SPIRAM_MALLOC_RESERVE_INTERNAL=65536
CONFIG_SPIRAM_TRY_ALLOCATE_WIFI_LWIP=y
CONFIG_MBEDTLS_EXTERNAL_MEM_ALLOC=y
```

## main/Kconfig.projbuild
```kconfig
menu "SpoolBuddy"
config SB_OTA_MANIFEST_URL
    string "Project OTA manifest URL (HTTPS)"
    default "https://api.github.com/repos/tbc0309/spoolbuddy-esp32/contents/ota.json?ref=main"
config SB_WIFI_SSID
    string "Wi-Fi SSID"
    default ""
config SB_WIFI_PASSWORD
    string "Wi-Fi password"
    default ""
config SB_BACKEND_URL
    string "Bambuddy URL (without /api/v1)"
    default "http://192.168.1.100:8000"
config SB_API_KEY
    string "Bambuddy API key"
    default ""
config SB_NFC
    bool "Enable PN5180"
    default y
config SB_NFC_SCK
    int "PN5180 SCK GPIO"
    default -1
config SB_NFC_MOSI
    int "PN5180 MOSI GPIO"
    default -1
config SB_NFC_MISO
    int "PN5180 MISO GPIO"
    default -1
config SB_NFC_CS
    int "PN5180 NSS GPIO"
    default -1
config SB_NFC_BUSY
    int "PN5180 BUSY GPIO"
    default -1
config SB_NFC_RST
    int "PN5180 RST GPIO"
    default -1
config SB_SCALE
    bool "Enable NAU7802 on the board I2C bus"
    default y
endmenu
```

## sdkconfig.defaults
```kconfig
CONFIG_BOOTLOADER_LOG_LEVEL_WARN=y
CONFIG_PARTITION_TABLE_CUSTOM=y
CONFIG_ESP_MAIN_TASK_STACK_SIZE=16384
CONFIG_FREERTOS_HZ=1000
CONFIG_LV_OS_FREERTOS=y
CONFIG_LV_USE_CUSTOM_MALLOC=y
CONFIG_LV_USE_CLIB_STRING=y
CONFIG_LV_USE_CLIB_SPRINTF=y
CONFIG_LV_FONT_MONTSERRAT_20=y
CONFIG_LV_FONT_MONTSERRAT_32=y
CONFIG_LV_FONT_FMT_TXT_LARGE=y
CONFIG_MBEDTLS_CERTIFICATE_BUNDLE=y
CONFIG_ESP_WIFI_SOFTAP_SUPPORT=n
```
